## boards/others/twonkie_v2/Kconfig.twonkie_v2
```kconfig
# SPDX-FileCopyrightText: Copyright The Zephyr Project Contributors
# SPDX-License-Identifier: Apache-2.0

config BOARD_TWONKIE_V2
	select SOC_STM32F072XB
```

## boards/others/twonkie_v2/board.yml
```yaml
# SPDX-FileCopyrightText: Copyright The Zephyr Project Contributors
# SPDX-License-Identifier: Apache-2.0

board:
  name: twonkie_v2
  full_name: Twonkie v2
  vendor: others
  socs:
    - name: stm32f072xb
```

## drivers/usb_c/tcpc/Kconfig.tcpc_stm32
```kconfig
# USB-C STM32 TCPC device configuration options

# Copyright 2022 The Chromium OS Authors
# SPDX-License-Identifier: Apache-2.0

config USBC_TCPC_STM32
	bool "USB-C TCPC device controller driver"
	default y
	depends on DT_HAS_ST_STM32_UCPD_ENABLED
	select PINCTRL
	select USBC_TCPC_DEAD_BATTERY if \
		$(dt_compat_any_has_prop,$(DT_COMPAT_ST_STM32_UCPD),dead-battery,True)
	help
	  Enable USB-C TCPC support on the STM32 G0, G4, L5, and U5 family of
	  processors.
```

## dts/bindings/sensor/ti,ina2xx-common.yaml
```yaml
#
# Copyright 2021 Grinn
#
# SPDX-License-Identifier: Apache-2.0
#

include: [sensor-device.yaml, i2c-device.yaml]

properties:
  current-lsb-microamps:
    type: int
    required: true
    description: |
      This value should be selected so that measurement resolution is
      maximized, that is:

        current-lsb(A) = maximum expected current(A) / 2^15

      (sensor has 15 bits). For example, if maximum expected current is 15A:

        current-lsb(A) = 15A / 2^15 ~= 457uA

      Rounded values may be used for convenience, e.g. 500uA/LSB or 1mA/LSB
      while keeping a good measurement resolution. The units are in uA/LSB
      so that low maximum currents can be measured with enough resolution.

  rshunt-micro-ohms:
    type: int
    required: true
    description: Shunt resistor value in microOhms

  alert-gpios:
    type: phandle-array
    description: Alert pin

  fetch-channels:
    type: string-array
    enum:
      - bus-voltage
      - shunt-voltage
      - current
      - power
      - die-temperature
      - energy
      - charge
    description: |
      Channels read by SENSOR_CHAN_ALL, in the driver's normal register order.
      If omitted, all channels supported by the device are read, preserving
      the default behavior. The list must be nonempty and contain only channels
      supported by the device variant. Explicit single-channel fetches remain
      available, including channels not listed here. Retrieve a channel only
      after fetching it; unselected cached values are not refreshed by ALL.
      This property controls I2C register reads, not ADC operating mode,
      conversion time, averaging, or physical conversion enablement. Configure
      those separately. For example, [bus-voltage, shunt-voltage] avoids reading
      current, power and temperature when only raw bus/shunt data is needed.
```
